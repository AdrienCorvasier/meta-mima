## conf/distro/mima.conf
```bitbake
require conf/distro/poky.conf

DISTRO = "mima"
DISTRO_NAME = "MIMA (Micro Inspection Lake AUV)"
DISTRO_VERSION = "1.0"
DISTRO_CODENAME = "wrynose"
MAINTAINER = "Adrien <adrien.c.72@gmail.com>"

SDK_VENDOR = "-mimasdk"
SDK_VERSION := "${DISTRO_VERSION}"

# Start from poky's DISTRO_FEATURES and adjust
DISTRO_FEATURES:append = " ssh-server-openssh can systemd usrmerge"
DISTRO_FEATURES_OPTED_OUT:append = " bluetooth"
DISTRO_FEATURES:remove = " x11 wayland sysvinit"

# Package format
PACKAGE_CLASSES ?= "package_ipk"
LICENSE_FLAGS_ACCEPTED:append = " synaptics-killswitch"

# Init system
VIRTUAL-RUNTIME_init_manager = "systemd"
VIRTUAL-RUNTIME_initscripts = ""
```
